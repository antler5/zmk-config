## config/west.yml
```yaml
manifest:
  remotes:
    - name: zmkfirmware
      url-base: https://github.com/zmkfirmware
    - name: AutumnalAntlers
      url-base: https://github.com/AutumnalAntlers
  projects:
    - name: zmk
      remote: AutumnalAntlers
      revision: magic
      import: app/west.yml
  self:
    path: config
```
